#ifdef TASK8

#include "reg51.h"
#include "timer.h"
#include "nixie.h"
#include "stdbool.h"
#include "dac0832.h"
#include "util.h"

#ifdef USE_SIN_RATE
// 正弦波电压等级的百分比, x = [0, 359], SIN_RATE[x] = (sin(x) + 1) / 2 * 100 = [0, 100]
uint8_t __code SIN_RATE[] = {
        50, 51, 52, 53, 53, 54, 55, 56, 57, 58, 59, 60, 60, 61, 62, 63, 64, 65, 65, 66, 67, 68, 69, 70, 70, 71, 72, 73,
        73, 74, 75, 76, 76, 77, 78, 79, 79, 80, 81, 81, 82, 83, 83, 84, 85, 85, 86, 87, 87, 88, 88, 89, 89, 90, 90, 91,
        91, 92, 92, 93, 93, 94, 94, 95, 95, 95, 96, 96, 96, 97, 97, 97, 98, 98, 98, 98, 99, 99, 99, 99, 99, 99, 100,
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        40, 40, 41, 42, 43, 44, 45, 46, 47, 47, 48, 49,
};
#else
// 正弦波电压等级 SIN_VAL[i] = SIN_RATE[i] * 255 / 100
uint8_t __code SIN_VAL[] = {
        127, 130, 132, 135, 135, 137, 140, 142, 145, 147, 150, 153, 153, 155, 158, 160, 163, 165, 165, 168, 170, 173,
        175, 178, 178, 181, 183, 186, 186, 188, 191, 193, 193, 196, 198, 201, 201, 204, 206, 206, 209, 211, 211, 214,
        216, 216, 219, 221, 221, 224, 224, 226, 226, 229, 229, 232, 232, 234, 234, 237, 237, 239, 239, 242, 242, 242,
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        102, 104, 107, 109, 112, 114, 117, 119, 119, 122, 124,
};
#endif

uint16_t __code HZ[] = {1, 2, 4, 5, 10, 20, 25, 50, 100, 125};

int8_t hz_index = 0;

// 频率
uint16_t hz = 0;

// 周期 = 1000 / hz 毫秒
uint16_t cycle = 0;

// 半周期 = 周期 / 2 毫秒
uint16_t half_cycle = 0;

// 步长 = 2 * 256 / 半周期, 可输出 0-255 共 256 个等级的电压, 因为 256 / (1000 / 1Hz / 2) = 0.512, 将扩大2倍应对小数
uint16_t step = 0;

void nixie_write_uint16_at(int8_t start, uint16_t n) {
    bool is_prefix = true;
    for (uint16_t i = 1000; i != 0; i /= 10, ++start) {
        uint8_t mod = n / i % 10;
        if (is_prefix && mod == 0) {
            nixie_write_at(start, 0);
        } else {
            nixie_write_at(start, nixie_seg('0' + mod));
            is_prefix = false;
        }
    }
}

void update_param() {
    hz = HZ[hz_index];
    cycle = 1000 / hz;
    half_cycle = cycle / 2;
    step = 2 * 256 / half_cycle;
    nixie_write_uint16_at(0, cycle);
    nixie_write_uint16_at(4, hz);
}

enum Wave {
    // 正弦波
    SINUSOID_WARE,
    // 三角波
    TRIANGULAR_WAVE,
    // 锯齿波
    SAWTOOTH_WAVE,
    // 方波
    SQUARE_WAVE
} wave = SINUSOID_WARE;

void generate_wave() {
    static uint16_t i = 0;
    if (wave == SINUSOID_WARE) {
#ifdef USE_SIN_RATE
        dac0832_send_da(SIN_RATE[(uint32_t) 360 * i / cycle] * 255 / 100);
#else
        if (i % 2 == 0) dac0832_send_da(SIN_VAL[(uint32_t) 360 * i / cycle]);
#endif
    } else if (wave == TRIANGULAR_WAVE) {
        dac0832_send_da(i < half_cycle ? i * step / 2 : (cycle - i) * step / 2);
    } else if (wave == SAWTOOTH_WAVE) {
        dac0832_send_da(i * step / 2);
    } else if (wave == SQUARE_WAVE) {
        dac0832_send_da(i < half_cycle ? 0xFF : 0x00);
    }
    if (++i >= cycle) {
        i = 0;
    }
}

#define KEY_PRESS(P__, body) if (P__ == 0) body

void key_scan() {
    static uint8_t prev = 0;
    uint8_t curr = 0;
    KEY_PRESS(P2_5, wave = SINUSOID_WARE);
    KEY_PRESS(P2_6, wave = TRIANGULAR_WAVE);
    KEY_PRESS(P2_7, wave = SAWTOOTH_WAVE);
    KEY_PRESS(P3_5, wave = SQUARE_WAVE);
    KEY_PRESS(P3_6, curr |= 0x10);
    KEY_PRESS(P3_7, curr |= 0x20);
    if (curr == 0 && prev != 0) {
        if (prev == 0x10) {
            hz_index = hz_index <= 0 ? LENGTH_OF(HZ) - 1 : hz_index - 1;
        }
        if (prev == 0x20) {
            hz_index = hz_index >= LENGTH_OF(HZ) - 1 ? 0 : hz_index + 1;
        }
        update_param();
    }
    prev = curr;
}

void timer0_isr() __interrupt(TF0_VECTOR) {
    TL0 = 0x66;
    TH0 = 0xFC;
    key_scan();
    nixie_scan();
    generate_wave();
}

int main() {
    update_param();
    timer0_init();
    EA = 1;
    while (true);
}

#endif //TASK8
